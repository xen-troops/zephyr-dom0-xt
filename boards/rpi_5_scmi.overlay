/*
 * Copyright (C) 2024 EPAM Systems.
 *
 * SPDX-License-Identifier: Apache-2.0
 */

 /delete-node/ &sram0;

#include <mem.h>

/ {
	#address-cells = <2>;
	#size-cells = <1>;

	sram0: memory@30000000 {
		compatible = "mmio-sram";
		reg = <0x00 0x30000000 DT_SIZE_M(128)>;
	};
};
